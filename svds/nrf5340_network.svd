# nrf5340_network register map
Vendor: Nordic Semiconductor; Series: nrf53; File version: 1
nRF53 reference description for system-on-chip with dual ARM 32-bit Cortex-M33 microcontrollers
CPU: CM33 r0p4, little endian, MPU, no FPU, 3 interrupt priority bits, 30 interrupts
Registers are 32-bit, read-write, reset 0x0 unless marked. A register's access mark holds for its fields unless they carry their own. Offsets are from the block's base; lines under a group give offsets from that group; [hi:lo] are bit positions; {n}, {i} and the like mark numbered series; 'fields as' and 'values as' point back to an identical list; <NAME> marks a mode.

## Memory map
0x01FF0000 FICR_NS size 0x1000 — Factory Information Configuration Registers
0x01FF8000 UICR_NS size 0x1000 — User Information Configuration Registers
0x40030000 APPMUTEX_NS size 0x1000 — MUTEX 0
0x41000000 DCNF_NS size 0x1000 — Domain configuration management
0x41004000 VREQCTRL_NS size 0x1000 — Voltage request control
0x41005000 CLOCK_NS size 0x1000 — Clock management
0x41005000 POWER_NS size 0x1000 — Power control
0x41005000 RESET_NS size 0x1000 — Reset control
0x41006000 CTRLAP_NS size 0x1000 — Control access port
0x41008000 RADIO_NS size 0x1000 — 2.4 GHz radio
0x41009000 RNG_NS size 0x1000 — Random Number Generator
0x4100A000 GPIOTE_NS size 0x1000 — GPIO Tasks and Events
0x4100B000 WDT_NS size 0x1000 — Watchdog Timer
0x4100C000 TIMER0_NS size 0x1000 — Timer/Counter 0
0x4100D000 ECB_NS size 0x1000 — AES ECB Mode Encryption
0x4100E000 AAR_NS size 0x1000 — Accelerated Address Resolver
0x4100E000 CCM_NS size 0x1000 — AES CCM mode encryption
0x4100F000 DPPIC_NS size 0x1000 — Distributed programmable peripheral interconnect controller
0x41010000 TEMP_NS size 0x1000 — Temperature Sensor
0x41011000 RTC0_NS size 0x1000 — Real-time counter 0
0x41012000 IPC_NS size 0x1000 — Interprocessor communication
0x41013000 SPIM0_NS size 0x1000 — Serial Peripheral Interface Master with EasyDMA
0x41013000 SPIS0_NS size 0x1000 — SPI Slave
0x41013000 TWIM0_NS size 0x1000 — I2C compatible Two-Wire Master Interface with EasyDMA
0x41013000 TWIS0_NS size 0x1000 — I2C compatible Two-Wire Slave Interface with EasyDMA
0x41013000 UARTE0_NS size 0x1000 — UART with EasyDMA
0x41014000 EGU0_NS size 0x1000 — Event generator unit
0x41016000 RTC1_NS size 0x1000 — Real-time counter 1
0x41018000 TIMER1_NS size 0x1000 — Timer/Counter 1
0x41019000 TIMER2_NS size 0x1000 — Timer/Counter 2
0x4101A000 SWI0_NS size 0x1000 — Software interrupt 0
0x4101B000 SWI1_NS size 0x1000 — Software interrupt 1
0x4101C000 SWI2_NS size 0x1000 — Software interrupt 2
0x4101D000 SWI3_NS size 0x1000 — Software interrupt 3
0x41080000 ACL_NS size 0x1000 — Access control lists
0x41080000 NVMC_NS size 0x1000 — Non-volatile memory controller
0x41081000 VMC_NS size 0x1000 — Volatile Memory controller
0x418C0500 P0_NS size 0x300 — GPIO Port 0
0x418C0800 P1_NS size 0x300 — GPIO Port 1
0x50030000 APPMUTEX_S size 0x1000 — MUTEX 1
0xE0042000 CTI_NS size 0x1000 — Cross-Trigger Interface control. NOTE: this is not a separate peripheral, but describes CM33 functionality.

## Interrupts
5 CLOCK_POWER (CLOCK_NS, POWER_NS)
8 RADIO (RADIO_NS)
9 RNG (RNG_NS)
10 GPIOTE (GPIOTE_NS)
11 WDT (WDT_NS)
12 TIMER0 (TIMER0_NS)
13 ECB (ECB_NS)
14 AAR_CCM (AAR_NS, CCM_NS)
16 TEMP (TEMP_NS)
17 RTC0 (RTC0_NS)
18 IPC (IPC_NS)
19 SERIAL0 (SPIM0_NS, SPIS0_NS, TWIM0_NS, TWIS0_NS, UARTE0_NS)
20 EGU0 (EGU0_NS)
22 RTC1 (RTC1_NS)
24 TIMER1 (TIMER1_NS)
25 TIMER2 (TIMER2_NS)
26 SWI0 (SWI0_NS)
27 SWI1 (SWI1_NS)
28 SWI2 (SWI2_NS)
29 SWI3 (SWI3_NS)

## Further device data
MaxInterrupts=129

## Licence text in the file
Copyright (c) 2010 - 2025, Nordic Semiconductor ASA All rights reserved. SPDX-License-Identifier: BSD-3-Clause Redistribution and use in source and binary forms, with or without modification, are permitted provided that the following conditions are met: 1. Redistributions of source code must retain the above copyright notice, this list of conditions and the following disclaimer. 2. Redistributions in binary form must reproduce the above copyright notice, this list of conditions and the following disclaimer in the documentation and/or other materials provided with the distribution. 3. Neither the name of Nordic Semiconductor ASA nor the names of its contributors may be used to endorse or promote products derived from this software without specific prior written permission. THIS SOFTWARE IS PROVIDED BY THE COPYRIGHT HOLDERS AND CONTRIBUTORS "AS IS" AND ANY EXPRESS OR IMPLIED WARRANTIES, INCLUDING, BUT NOT LIMITED TO, THE IMPLIED WARRANTIES OF MERCHANTABILITY, AND FITNESS FOR A PARTICULAR PURPOSE ARE DISCLAIMED. IN NO EVENT SHALL NORDIC SEMICONDUCTOR ASA OR CONTRIBUTORS BE LIABLE FOR ANY DIRECT, INDIRECT, INCIDENTAL, SPECIAL, EXEMPLARY, OR CONSEQUENTIAL DAMAGES (INCLUDING, BUT NOT LIMITED TO, PROCUREMENT OF SUBSTITUTE GOODS OR SERVICES; LOSS OF USE, DATA, OR PROFITS; OR BUSINESS INTERRUPTION) HOWEVER CAUSED AND ON ANY THEORY OF LIABILITY, WHETHER IN CONTRACT, STRICT LIABILITY, OR TORT (INCLUDING NEGLIGENCE OR OTHERWISE) ARISING IN ANY WAY OUT OF THE USE OF THIS SOFTWARE, EVEN IF ADVISED OF THE POSSIBILITY OF SUCH DAMAGE.
