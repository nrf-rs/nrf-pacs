# nrf5340_application register map
Vendor: Nordic Semiconductor; Series: nrf53; File version: 1
nRF53 reference description for system-on-chip with dual ARM 32-bit Cortex-M33 microcontrollers
CPU: CM33 r0p4, little endian, MPU, FPU, 3 interrupt priority bits, 69 interrupts
Registers are 32-bit, read-write, reset 0x0 unless marked. A register's access mark holds for its fields unless they carry their own. Offsets are from the block's base; lines under a group give offsets from that group; [hi:lo] are bit positions; {n}, {i} and the like mark numbered series; 'fields as' and 'values as' point back to an identical list; <NAME> marks a mode.

## Memory map
0x00F00000 CACHEDATA_S size 0x1000 — CACHEDATA
0x00F08000 CACHEINFO_S size 0x1000 — CACHEINFO
0x00FF0000 FICR_S size 0x1000 — Factory Information Configuration Registers
0x00FF8000 UICR_S size 0x1000 — User Information Configuration Registers User information configuration registers
0x40000000 DCNF_NS size 0x1000 — Domain configuration management 0
0x40000000 FPU_NS size 0x1000 — FPU control peripheral 0
0x40004000 OSCILLATORS_NS size 0x1000 — Oscillator control 0
0x40004000 REGULATORS_NS size 0x1000 — Voltage regulators 0
0x40005000 CLOCK_NS size 0x1000 — Clock management 0
0x40005000 POWER_NS size 0x1000 — Power control 0
0x40005000 RESET_NS size 0x1000 — Reset control 0
0x40006000 CTRLAP_NS size 0x1000 — Control access port 0
0x40008000 SPIM0_NS size 0x1000 — Serial Peripheral Interface Master with EasyDMA 0
0x40008000 SPIS0_NS size 0x1000 — SPI Slave 0
0x40008000 TWIM0_NS size 0x1000 — I2C compatible Two-Wire Master Interface with EasyDMA 0
0x40008000 TWIS0_NS size 0x1000 — I2C compatible Two-Wire Slave Interface with EasyDMA 0
0x40008000 UARTE0_NS size 0x1000 — UART with EasyDMA 0
0x40009000 SPIM1_NS size 0x1000 — Serial Peripheral Interface Master with EasyDMA 2
0x40009000 SPIS1_NS size 0x1000 — SPI Slave 2
0x40009000 TWIM1_NS size 0x1000 — I2C compatible Two-Wire Master Interface with EasyDMA 2
0x40009000 TWIS1_NS size 0x1000 — I2C compatible Two-Wire Slave Interface with EasyDMA 2
0x40009000 UARTE1_NS size 0x1000 — UART with EasyDMA 2
0x4000A000 SPIM4_NS size 0x1000 — Serial Peripheral Interface Master with EasyDMA 4
0x4000B000 SPIM2_NS size 0x1000 — Serial Peripheral Interface Master with EasyDMA 6
0x4000B000 SPIS2_NS size 0x1000 — SPI Slave 4
0x4000B000 TWIM2_NS size 0x1000 — I2C compatible Two-Wire Master Interface with EasyDMA 4
0x4000B000 TWIS2_NS size 0x1000 — I2C compatible Two-Wire Slave Interface with EasyDMA 4
0x4000B000 UARTE2_NS size 0x1000 — UART with EasyDMA 4
0x4000C000 SPIM3_NS size 0x1000 — Serial Peripheral Interface Master with EasyDMA 8
0x4000C000 SPIS3_NS size 0x1000 — SPI Slave 6
0x4000C000 TWIM3_NS size 0x1000 — I2C compatible Two-Wire Master Interface with EasyDMA 6
0x4000C000 TWIS3_NS size 0x1000 — I2C compatible Two-Wire Slave Interface with EasyDMA 6
0x4000C000 UARTE3_NS size 0x1000 — UART with EasyDMA 6
0x4000E000 SAADC_NS size 0x1000 — Analog to Digital Converter 0
0x4000F000 TIMER0_NS size 0x1000 — Timer/Counter 0
0x40010000 TIMER1_NS size 0x1000 — Timer/Counter 2
0x40011000 TIMER2_NS size 0x1000 — Timer/Counter 4
0x40014000 RTC0_NS size 0x1000 — Real-time counter 0
0x40015000 RTC1_NS size 0x1000 — Real-time counter 2
0x40017000 DPPIC_NS size 0x1000 — Distributed programmable peripheral interconnect controller 0
0x40018000 WDT0_NS size 0x1000 — Watchdog Timer 0
0x40019000 WDT1_NS size 0x1000 — Watchdog Timer 2
0x4001A000 COMP_NS size 0x1000 — Comparator 0
0x4001A000 LPCOMP_NS size 0x1000 — Low-power comparator 0
0x4001B000 EGU0_NS size 0x1000 — Event generator unit 0
0x4001C000 EGU1_NS size 0x1000 — Event generator unit 2
0x4001D000 EGU2_NS size 0x1000 — Event generator unit 4
0x4001E000 EGU3_NS size 0x1000 — Event generator unit 6
0x4001F000 EGU4_NS size 0x1000 — Event generator unit 8
0x40020000 EGU5_NS size 0x1000 — Event generator unit 10
0x40021000 PWM0_NS size 0x1000 — Pulse width modulation unit 0
0x40022000 PWM1_NS size 0x1000 — Pulse width modulation unit 2
0x40023000 PWM2_NS size 0x1000 — Pulse width modulation unit 4
0x40024000 PWM3_NS size 0x1000 — Pulse width modulation unit 6
0x40026000 PDM0_NS size 0x1000 — Pulse Density Modulation (Digital Microphone) Interface 0
0x40028000 I2S0_NS size 0x1000 — Inter-IC Sound 0
0x4002A000 IPC_NS size 0x1000 — Interprocessor communication 0
0x4002B000 QSPI_NS size 0x1000 — External flash interface 0
0x4002D000 NFCT_NS size 0x1000 — NFC-A compatible radio 0
0x4002F000 GPIOTE1_NS size 0x1000 — GPIO Tasks and Events 1
0x40030000 MUTEX_NS size 0x1000 — MUTEX 0
0x40033000 QDEC0_NS size 0x1000 — Quadrature Decoder 0
0x40034000 QDEC1_NS size 0x1000 — Quadrature Decoder 2
0x40036000 USBD_NS size 0x1000 — Universal serial bus device 0
0x40037000 USBREGULATOR_NS size 0x1000 — USB Regulator 0
0x40039000 KMU_NS size 0x1000 — Key management unit 0
0x40039000 NVMC_NS size 0x1000 — Non-volatile memory controller 0
0x40081000 VMC_NS size 0x1000 — Volatile Memory controller 0
0x40842500 P0_NS size 0x300 — GPIO Port 0
0x40842800 P1_NS size 0x300 — GPIO Port 1
0x50000000 DCNF_S size 0x1000 — Domain configuration management 1
0x50000000 FPU_S size 0x1000 — FPU control peripheral 1
0x50001000 CACHE_S size 0x1000 — Cache
0x50003000 SPU_S size 0x1000 — System protection unit
0x50004000 OSCILLATORS_S size 0x1000 — Oscillator control 1
0x50004000 REGULATORS_S size 0x1000 — Voltage regulators 1
0x50005000 CLOCK_S size 0x1000 — Clock management 1
0x50005000 POWER_S size 0x1000 — Power control 1
0x50005000 RESET_S size 0x1000 — Reset control 1
0x50006000 CTRLAP_S size 0x1000 — Control access port 1
0x50008000 SPIM0_S size 0x1000 — Serial Peripheral Interface Master with EasyDMA 1
0x50008000 SPIS0_S size 0x1000 — SPI Slave 1
0x50008000 TWIM0_S size 0x1000 — I2C compatible Two-Wire Master Interface with EasyDMA 1
0x50008000 TWIS0_S size 0x1000 — I2C compatible Two-Wire Slave Interface with EasyDMA 1
0x50008000 UARTE0_S size 0x1000 — UART with EasyDMA 1
0x50009000 SPIM1_S size 0x1000 — Serial Peripheral Interface Master with EasyDMA 3
0x50009000 SPIS1_S size 0x1000 — SPI Slave 3
0x50009000 TWIM1_S size 0x1000 — I2C compatible Two-Wire Master Interface with EasyDMA 3
0x50009000 TWIS1_S size 0x1000 — I2C compatible Two-Wire Slave Interface with EasyDMA 3
0x50009000 UARTE1_S size 0x1000 — UART with EasyDMA 3
0x5000A000 SPIM4_S size 0x1000 — Serial Peripheral Interface Master with EasyDMA 5
0x5000B000 SPIM2_S size 0x1000 — Serial Peripheral Interface Master with EasyDMA 7
0x5000B000 SPIS2_S size 0x1000 — SPI Slave 5
0x5000B000 TWIM2_S size 0x1000 — I2C compatible Two-Wire Master Interface with EasyDMA 5
0x5000B000 TWIS2_S size 0x1000 — I2C compatible Two-Wire Slave Interface with EasyDMA 5
0x5000B000 UARTE2_S size 0x1000 — UART with EasyDMA 5
0x5000C000 SPIM3_S size 0x1000 — Serial Peripheral Interface Master with EasyDMA 9
0x5000C000 SPIS3_S size 0x1000 — SPI Slave 7
0x5000C000 TWIM3_S size 0x1000 — I2C compatible Two-Wire Master Interface with EasyDMA 7
0x5000C000 TWIS3_S size 0x1000 — I2C compatible Two-Wire Slave Interface with EasyDMA 7
0x5000C000 UARTE3_S size 0x1000 — UART with EasyDMA 7
0x5000D000 GPIOTE0_S size 0x1000 — GPIO Tasks and Events 0
0x5000E000 SAADC_S size 0x1000 — Analog to Digital Converter 1
0x5000F000 TIMER0_S size 0x1000 — Timer/Counter 1
0x50010000 TIMER1_S size 0x1000 — Timer/Counter 3
0x50011000 TIMER2_S size 0x1000 — Timer/Counter 5
0x50014000 RTC0_S size 0x1000 — Real-time counter 1
0x50015000 RTC1_S size 0x1000 — Real-time counter 3
0x50017000 DPPIC_S size 0x1000 — Distributed programmable peripheral interconnect controller 1
0x50018000 WDT0_S size 0x1000 — Watchdog Timer 1
0x50019000 WDT1_S size 0x1000 — Watchdog Timer 3
0x5001A000 COMP_S size 0x1000 — Comparator 1
0x5001A000 LPCOMP_S size 0x1000 — Low-power comparator 1
0x5001B000 EGU0_S size 0x1000 — Event generator unit 1
0x5001C000 EGU1_S size 0x1000 — Event generator unit 3
0x5001D000 EGU2_S size 0x1000 — Event generator unit 5
0x5001E000 EGU3_S size 0x1000 — Event generator unit 7
0x5001F000 EGU4_S size 0x1000 — Event generator unit 9
0x50020000 EGU5_S size 0x1000 — Event generator unit 11
0x50021000 PWM0_S size 0x1000 — Pulse width modulation unit 1
0x50022000 PWM1_S size 0x1000 — Pulse width modulation unit 3
0x50023000 PWM2_S size 0x1000 — Pulse width modulation unit 5
0x50024000 PWM3_S size 0x1000 — Pulse width modulation unit 7
0x50026000 PDM0_S size 0x1000 — Pulse Density Modulation (Digital Microphone) Interface 1
0x50028000 I2S0_S size 0x1000 — Inter-IC Sound 1
0x5002A000 IPC_S size 0x1000 — Interprocessor communication 1
0x5002B000 QSPI_S size 0x1000 — External flash interface 1
0x5002D000 NFCT_S size 0x1000 — NFC-A compatible radio 1
0x50030000 MUTEX_S size 0x1000 — MUTEX 1
0x50033000 QDEC0_S size 0x1000 — Quadrature Decoder 1
0x50034000 QDEC1_S size 0x1000 — Quadrature Decoder 3
0x50036000 USBD_S size 0x1000 — Universal serial bus device 1
0x50037000 USBREGULATOR_S size 0x1000 — USB Regulator 1
0x50039000 KMU_S size 0x1000 — Key management unit 1
0x50039000 NVMC_S size 0x1000 — Non-volatile memory controller 1
0x50081000 VMC_S size 0x1000 — Volatile Memory controller 1
0x50842500 P0_S size 0x300 — GPIO Port 2
0x50842800 P1_S size 0x300 — GPIO Port 3
0x50844000 CRYPTOCELL_S size 0x1000 — CRYPTOCELL register interface
0x50845000 CC_AES_S size 0x1000 — CRYPTOCELL AES engine
0x50845000 CC_AHB_S size 0x1000 — CRYPTOCELL AHB interface
0x50845000 CC_AO_S size 0x1000 — CryptoCell AO
0x50845000 CC_CHACHA_S size 0x1000 — CRYPTOCELL CHACHA engine
0x50845000 CC_CTL_S size 0x1000 — CRYPTOCELL CTL interface
0x50845000 CC_DIN_S size 0x1000 — CRYPTOCELL Data IN interface
0x50845000 CC_DOUT_S size 0x1000 — CRYPTOCELL Data OUT interface
0x50845000 CC_GHASH_S size 0x1000 — CRYPTOCELL GHASH engine
0x50845000 CC_HASH_S size 0x1000 — CRYPTOCELL HASH engine
0x50845000 CC_HOST_RGF_S size 0x1000 — CRYPTOCELL HOST register interface
0x50845000 CC_MISC_S size 0x1000 — CRYPTOCELL MISC interface
0x50845000 CC_PKA_S size 0x1000 — CRYPTOCELL PKA engine
0x50845000 CC_RNG_S size 0x1000 — CRYPTOCELL RNG engine
0x50845000 CC_RNG_SRAM_S size 0x1000 — CRYPTOCELL RNG SRAM interface
0xE0042000 CTI_S size 0x1000 — Cross-Trigger Interface control. NOTE: this is not a separate peripheral, but describes CM33 functionality.
0xE0080000 TAD_S size 0x1000 — Trace and debug control

## Interrupts
0 FPU (FPU_NS, FPU_S)
1 CACHE (CACHE_S)
3 SPU (SPU_S)
5 CLOCK_POWER (CLOCK_NS, POWER_NS, CLOCK_S, POWER_S)
8 SERIAL0 (SPIM0_NS, SPIS0_NS, TWIM0_NS, TWIS0_NS, UARTE0_NS, SPIM0_S, SPIS0_S, TWIM0_S, TWIS0_S, UARTE0_S)
9 SERIAL1 (SPIM1_NS, SPIS1_NS, TWIM1_NS, TWIS1_NS, UARTE1_NS, SPIM1_S, SPIS1_S, TWIM1_S, TWIS1_S, UARTE1_S)
10 SPIM4 (SPIM4_NS, SPIM4_S)
11 SERIAL2 (SPIM2_NS, SPIS2_NS, TWIM2_NS, TWIS2_NS, UARTE2_NS, SPIM2_S, SPIS2_S, TWIM2_S, TWIS2_S, UARTE2_S)
12 SERIAL3 (SPIM3_NS, SPIS3_NS, TWIM3_NS, TWIS3_NS, UARTE3_NS, SPIM3_S, SPIS3_S, TWIM3_S, TWIS3_S, UARTE3_S)
13 GPIOTE0 (GPIOTE0_S)
14 SAADC (SAADC_NS, SAADC_S)
15 TIMER0 (TIMER0_NS, TIMER0_S)
16 TIMER1 (TIMER1_NS, TIMER1_S)
17 TIMER2 (TIMER2_NS, TIMER2_S)
20 RTC0 (RTC0_NS, RTC0_S)
21 RTC1 (RTC1_NS, RTC1_S)
24 WDT0 (WDT0_NS, WDT0_S)
25 WDT1 (WDT1_NS, WDT1_S)
26 COMP_LPCOMP (COMP_NS, LPCOMP_NS, COMP_S, LPCOMP_S)
27 EGU0 (EGU0_NS, EGU0_S)
28 EGU1 (EGU1_NS, EGU1_S)
29 EGU2 (EGU2_NS, EGU2_S)
30 EGU3 (EGU3_NS, EGU3_S)
31 EGU4 (EGU4_NS, EGU4_S)
32 EGU5 (EGU5_NS, EGU5_S)
33 PWM0 (PWM0_NS, PWM0_S)
34 PWM1 (PWM1_NS, PWM1_S)
35 PWM2 (PWM2_NS, PWM2_S)
36 PWM3 (PWM3_NS, PWM3_S)
38 PDM0 (PDM0_NS, PDM0_S)
40 I2S0 (I2S0_NS, I2S0_S)
42 IPC (IPC_NS, IPC_S)
43 QSPI (QSPI_NS, QSPI_S)
45 NFCT (NFCT_NS, NFCT_S)
47 GPIOTE1 (GPIOTE1_NS)
51 QDEC0 (QDEC0_NS, QDEC0_S)
52 QDEC1 (QDEC1_NS, QDEC1_S)
54 USBD (USBD_NS, USBD_S)
55 USBREGULATOR (USBREGULATOR_NS, USBREGULATOR_S)
57 KMU (KMU_NS, KMU_S)
68 CRYPTOCELL (CRYPTOCELL_S)

## Further device data
MaxInterrupts=240

## Licence text in the file
Copyright (c) 2010 - 2025, Nordic Semiconductor ASA All rights reserved. SPDX-License-Identifier: BSD-3-Clause Redistribution and use in source and binary forms, with or without modification, are permitted provided that the following conditions are met: 1. Redistributions of source code must retain the above copyright notice, this list of conditions and the following disclaimer. 2. Redistributions in binary form must reproduce the above copyright notice, this list of conditions and the following disclaimer in the documentation and/or other materials provided with the distribution. 3. Neither the name of Nordic Semiconductor ASA nor the names of its contributors may be used to endorse or promote products derived from this software without specific prior written permission. THIS SOFTWARE IS PROVIDED BY THE COPYRIGHT HOLDERS AND CONTRIBUTORS "AS IS" AND ANY EXPRESS OR IMPLIED WARRANTIES, INCLUDING, BUT NOT LIMITED TO, THE IMPLIED WARRANTIES OF MERCHANTABILITY, AND FITNESS FOR A PARTICULAR PURPOSE ARE DISCLAIMED. IN NO EVENT SHALL NORDIC SEMICONDUCTOR ASA OR CONTRIBUTORS BE LIABLE FOR ANY DIRECT, INDIRECT, INCIDENTAL, SPECIAL, EXEMPLARY, OR CONSEQUENTIAL DAMAGES (INCLUDING, BUT NOT LIMITED TO, PROCUREMENT OF SUBSTITUTE GOODS OR SERVICES; LOSS OF USE, DATA, OR PROFITS; OR BUSINESS INTERRUPTION) HOWEVER CAUSED AND ON ANY THEORY OF LIABILITY, WHETHER IN CONTRACT, STRICT LIABILITY, OR TORT (INCLUDING NEGLIGENCE OR OTHERWISE) ARISING IN ANY WAY OUT OF THE USE OF THIS SOFTWARE, EVEN IF ADVISED OF THE POSSIBILITY OF SUCH DAMAGE.
